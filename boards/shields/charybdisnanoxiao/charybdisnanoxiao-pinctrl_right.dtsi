
#include <dt-bindings/zmk/matrix_transform.h>
#include <dt-bindings/pinctrl/nrf-pinctrl.h>
#include "charybdisnanoxiao-layouts.dtsi"

/ {
    chosen {
        //zephyr,display = &oled_128x32;
    };
};


